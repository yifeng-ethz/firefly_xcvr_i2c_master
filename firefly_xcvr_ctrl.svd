# MU3E_FIREFLY_XCVR_CTRL register map
Vendor: Mu3e; Series: MU3E_FPGA_IP; File version: 26.0.330
CMSIS-SVD description of the Firefly optical-module I2C monitor aperture. BaseAddress is 0 because this file describes the relative CSR aperture of the IP; system integration supplies the live slave base address.
Registers are 32-bit, read-only, reset 0x0 unless marked. A register's access mark holds for its fields unless they carry their own. Offsets are from the block's base; lines under a group give offsets from that group; [hi:lo] are bit positions; {n}, {i} and the like mark numbered series; 'fields as' and 'values as' point back to an identical list; <NAME> marks a mode.

## Memory map
0x00000000 FIREFLY_XCVR_CTRL size 0x38 — Relative 14-word Firefly monitor aperture. Read semantics dominate; the first three words also accept control writes described in each register description.

## FIREFLY_XCVR_CTRL — Relative 14-word Firefly monitor aperture. Read semantics dominate; the first three words also accept control writes described in each register description.
Base 0x00000000
0x00 FF1_TEMP_STATUS rw — Firefly 1 status/control word. Reads return temperature in bits [7:0]. When hidden CSR mode is enabled, bits [27:24] expose present_n and int_n pins. Writing bit 0 enables or disables continuous I2C polling.
  [31:0] value — Raw 32-bit register word. Refer to the register description for read-versus-write semantics.
0x04 FF1_VCC_RESET rw — Firefly 1 VCC/control word. Reads return the low 16 bits of the VCC measurement. Writing bit 0 requests a Firefly reset pulse.
  fields as FF1_TEMP_STATUS
0x08 FF1_RXPWR1_HIDDEN rw — Firefly 1 RX power channel 1 on read. Writing bit 0 enables or disables the hidden CSR page that augments FF1_TEMP_STATUS.
  fields as FF1_TEMP_STATUS
{0x4+4i} FF1_RXPWR{i} (i=2..4) — Firefly 1 received optical power for channel {i} in the low 16 bits.
  fields as FF1_TEMP_STATUS
0x18 FF1_ALARM — Firefly 1 latched alarm/status flags. Bits clear on read inside the module according to the Firefly alarm semantics.
  fields as FF1_TEMP_STATUS
0x1C FF2_TEMP_STATUS — Firefly 2 status word. Reads return temperature in bits [7:0].
  fields as FF1_TEMP_STATUS
0x20 FF2_VCC — Firefly 2 VCC measurement in the low 16 bits.
  fields as FF1_TEMP_STATUS
{0x20+4i} FF2_RXPWR{i} (i=1..4) — Firefly 2 received optical power for channel {i} in the low 16 bits.
  fields as FF1_TEMP_STATUS
0x34 FF2_ALARM — Firefly 2 latched alarm/status flags. Bits clear on read inside the module according to the Firefly alarm semantics.
  fields as FF1_TEMP_STATUS
